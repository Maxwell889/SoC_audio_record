`timescale 1ns / 1ps

// -----------------------------------------------------------------------------
// Testbench: tb_i2s_rx_inmp441
// Function:
//   1. Generate 50 MHz clock and reset
//   2. Emulate microphone serial output on mic_sd
//   3. Feed two known 16-bit left-channel samples into the DUT
//   4. Self-check sample_valid / sample_data / FIFO write interface
// -----------------------------------------------------------------------------
module tb_i2s_rx_inmp441;

    localparam integer NUM_SAMPLES = 2;

    reg         clk_50m;
    reg         rst_n;
    reg         rx_enable;
    reg         clear;
    reg         mic_sd;
    wire        mic_sck;
    wire        mic_ws;
    wire        sample_valid;
    wire [15:0] sample_data;
    wire        fifo_wr_en;
    wire [15:0] fifo_wr_data;

    reg [15:0] expected_samples [0:NUM_SAMPLES-1];
    integer    tx_frame_idx;
    integer    tx_bit_idx;
    integer    rx_sample_idx;
    integer    error_count;

    i2s_rx_inmp441 dut (
        .clk_50m     (clk_50m),
        .rst_n       (rst_n),
        .rx_enable   (rx_enable),
        .clear       (clear),
        .mic_sd      (mic_sd),
        .mic_sck     (mic_sck),
        .mic_ws      (mic_ws),
        .sample_valid(sample_valid),
        .sample_data (sample_data),
        .fifo_wr_en  (fifo_wr_en),
        .fifo_wr_data(fifo_wr_data)
    );

    // Return the serial bit that should be driven on mic_sd next.
    // I2S left-slot formatting used here:
    //   - bit 0 is the mandatory 1-bit delay
    //   - bit 1..16 carry sample[15:0], MSB first
    function drive_bit;
        input [15:0] sample;
        input integer bit_idx;
        begin
            // bit_idx is the bit index that will be sampled on the next SCK rise.
            if ((bit_idx >= 1) && (bit_idx <= 16)) begin
                drive_bit = sample[16 - bit_idx];
            end else begin
                drive_bit = 1'b0;
            end
        end
    endfunction

    always #10 clk_50m = ~clk_50m; // 50 MHz

    // -------------------------------------------------------------------------
    // Simple microphone model
    // -------------------------------------------------------------------------
    // The DUT is the I2S master, so mic_sck / mic_ws are generated by the DUT.
    // This testbench acts like a simple I2S slave:
    //   - update mic_sd on SCK falling edges
    //   - let the DUT sample mic_sd on the following SCK rising edges
    //
    // This keeps mic_sd stable before the sampling edge.
    initial begin
        mic_sd      = 1'b0;
        tx_frame_idx = 0;
        // Start with mic_sd held low, which effectively provides the delay bit.
        tx_bit_idx   = 1;

        wait (rst_n == 1'b1);

        forever begin
            @(negedge mic_sck);

            if (tx_frame_idx < NUM_SAMPLES) begin
                mic_sd <= drive_bit(expected_samples[tx_frame_idx], tx_bit_idx);
            end else begin
                mic_sd <= 1'b0;
            end

            if (tx_bit_idx == 63) begin
                tx_bit_idx = 0;

                if (tx_frame_idx < NUM_SAMPLES) begin
                    tx_frame_idx = tx_frame_idx + 1;
                end
            end else begin
                tx_bit_idx = tx_bit_idx + 1;
            end
        end
    end

    always @(posedge clk_50m) begin
        if (!rst_n) begin
            rx_sample_idx <= 0;
            error_count   <= 0;
        end else if (sample_valid) begin
            if (fifo_wr_en !== 1'b1) begin
                error_count <= error_count + 1;
                $display("[%0t] ERROR: fifo_wr_en should match sample_valid.", $time);
            end

            if (fifo_wr_data !== sample_data) begin
                error_count <= error_count + 1;
                $display("[%0t] ERROR: fifo_wr_data does not match sample_data.", $time);
            end

            if (rx_sample_idx >= NUM_SAMPLES) begin
                error_count <= error_count + 1;
                $display("[%0t] ERROR: unexpected extra sample 0x%04h.", $time, sample_data);
            end else if (sample_data !== expected_samples[rx_sample_idx]) begin
                error_count <= error_count + 1;
                $display("[%0t] ERROR: sample %0d mismatch, got 0x%04h expected 0x%04h.",
                         $time, rx_sample_idx, sample_data, expected_samples[rx_sample_idx]);
            end else begin
                $display("[%0t] INFO: sample %0d matched 0x%04h.",
                         $time, rx_sample_idx, sample_data);
            end

            rx_sample_idx <= rx_sample_idx + 1;
        end
    end

    // Monitor DUT outputs and automatically compare received samples.
    initial begin
        clk_50m            = 1'b0;
        rst_n              = 1'b0;
        rx_enable          = 1'b0;
        clear              = 1'b0;
        expected_samples[0] = 16'h1234;
        expected_samples[1] = 16'hA5C3;

        #200;
        rst_n     = 1'b1;
        rx_enable = 1'b1;
    end

    // Print final PASS/FAIL after both samples are received.
    initial begin
        wait (rst_n == 1'b1);
        wait (rx_sample_idx == NUM_SAMPLES);
        repeat (200) @(posedge clk_50m);

        if (error_count == 0) begin
            $display("TB PASS: received %0d expected samples.", NUM_SAMPLES);
        end else begin
            $display("TB FAIL: detected %0d error(s).", error_count);
        end

        $finish;
    end

    // Timeout protection in case the testbench gets stuck.
    initial begin
        #5000000;
        $display("TB FAIL: timeout waiting for samples.");
        $finish;
    end

endmodule
